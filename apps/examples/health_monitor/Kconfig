## os/board/qemu-armv8m/Kconfig
```kconfig
#
# QEMU MPS2-AN505 board configuration.
#

if ARCH_BOARD_QEMU_ARMV8M

config FLASH_START_ADDR
	hex
	default 0x80c00000
	---help---
		Start of the QEMU RAM-backed flash device. The upper 4 MiB of
		main RAM is reserved for persistent kernel and user binary slots.

config FLASH_SIZE
	int
	default 4194304

config FLASH_VSTART_LOADABLE
	hex
	default 0x80ca0000
	depends on XIP_ELF

config XIP_ELF_DUAL_SLOT
	bool
	default n
	depends on XIP_ELF
	---help---
		Generate XIP linker scripts and package artifacts for both A/B
		binary slots.

endif # ARCH_BOARD_QEMU_ARMV8M
```

## os/board/qemu-mps2-an505/Kconfig
```kconfig
#
# For a description of the syntax of this configuration file,
# see kconfig-language at https://www.kernel.org/doc/Documentation/kbuild/kconfig-language.txt
#

if ARCH_BOARD_QEMU_MPS2_AN505

menu "QEMU MPS2 AN505 Board Configuration"

config FLASH_VSTART
	hex
	default 0x10000000 if XIP_KERNEL
	default 0x28000000
	help
		Start virtual address of the flash image.

config FLASH_START_ADDR
	hex
	default 0x28000000
	help
		Start address of the flash image in the QEMU memory map.

config FLASH_VSTART_LOADABLE
	hex
	default 0x10000000 if XIP_ELF
	default 0x28080000
	help
		Loadable image execution base used for qemu-mps2-an505 runtime tests.

config FLASH_SIZE
	int
	default 4194304
	help
		Flash image size in bytes.

config QEMU_MPS2_AN505_TESTFS
	bool "Reserve board hook for runtime test filesystem setup"
	default y if QEMU_MPS2_AN505_PROFILE_BK7239N
	default y
	---help---
		Keep the board initialization hook available for the RAM-backed test
		filesystem plumbing that will be added with the qemu-mps2-an505
		runtime defconfigs.

config USERFS_MNTPT
	string
	default "/mnt" if AUTOMOUNT_USERFS
	---help---
		Default mount point for runtime filesystem checks on qemu-mps2-an505.

endmenu # "QEMU MPS2 AN505 Board Configuration"

endif # ARCH_BOARD_QEMU_MPS2_AN505
```

## os/fs/driver/mtd/rammtd/Kconfig
```kconfig
if RAMMTD

menu "RAM MTD options"

config RAMMTD_BLOCKSIZE
        int "RAM MTD block size"
        default 512

config RAMMTD_ERASESIZE
        int "RAM MTD erase block size"
        default 4096

config RAMMTD_ERASESTATE
        hex "Simulated erase state"
        default 0xff

config RAMMTD_FLASHSIM
	bool "RAM MTD FLASH Simulation"
	default n
        ---help---
		RAMMTD_FLASHSIM will add some extra logic to improve the level of
		FLASH simulation.

config RAMMTD_ERASE_ON_INIT
	bool "Erase RAM MTD on initialization"
	default y
	---help---
		Clear the backing memory when the RAM MTD device is initialized.
		Disable this for a persistent RAM-backed flash simulation.
endmenu

endif #RAMMTD
```

## os/kernel/health_monitor/Kconfig
```kconfig
config HEALTH_MONITOR
	bool "Opt-in Health Monitor core"
	default n
	depends on !SMP || ARCH_CHIP_AMEBASMART
	depends on !SCHED_TICKLESS && !SCHED_TICKSUPPRESS
	depends on !APP_BINARY_SEPARATION
	depends on !SUPPRESS_INTERRUPTS && !SUPPRESS_TIMER_INTS
	help
		Self-only non-blocking start/stop/kick with a CPU0 lazy heap.
		SMP uses single-writer publication and per-CPU bounded queues;
		no atomic API, exclusive instructions or shared locks. Requires
		coherent amebasmart RAM and real periodic CPU0 ticks. No automatic
		registrations or hardware watchdog provisioning. See
		docs/health_monitor.md for queue errors and publication limits.
```

## os/logdict/Kconfig
```kconfig
#
# For a description of the syntax of this configuration file,
# see kconfig-language at https://www.kernel.org/doc/Documentation/kbuild/kconfig-language.txt
#

config LOG_DICTIONARY
	bool "Dictionary based logging"
	default n
	depends on !WINDOWS_NATIVE
	---help---
		Replace selected log format strings with compact log records and
		generate a host-side dictionary for decoding.

if LOG_DICTIONARY

config LOG_DICTIONARY_KERNEL
	bool "Enable dictionary logging for os/kernel"
	default n
	---help---
		Apply dictionary logging to debug macros and selected printf calls
		compiled from os/kernel.

config LOG_DICTIONARY_MAX_STRLEN
	int "Maximum string argument length"
	default 64
	---help---
		Maximum number of bytes copied from a %s argument into one encoded
		log frame.

config LOG_DICTIONARY_TEXT_BUFSIZE
	int "Text frame buffer size"
	default 256
	---help---
		Stack buffer size used when emitting the initial text log frame.

config LOG_DICTIONARY_BINARY_FRAME
	bool "Binary dictionary log frame"
	default n
	depends on BROKEN
	---help---
		Reserved for the binary frame encoder. The record layout and host
		dictionary schema are kept compatible with this future encoder.

endif # LOG_DICTIONARY
```
