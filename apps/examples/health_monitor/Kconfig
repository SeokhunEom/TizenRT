## apps/examples/health_monitor/Kconfig
```kconfig
# SPDX-License-Identifier: Apache-2.0

config EXAMPLES_HEALTH_MONITOR
	bool "Health monitor validation example"
	default n
	depends on HEALTH_MONITOR && !DISABLE_PTHREAD
	---help---
		Enable the health_monitor command for normal kicks, explicit stop,
		thread exit, SMP lifecycle stress and intentional timeout testing.
		No thread is monitored until a command explicitly starts monitoring.
		The expire command deliberately triggers PANIC and board reset.
```

## apps/examples/health_monitor_armv8m/Kconfig
```kconfig
config EXAMPLES_HEALTH_MONITOR_ARMV8M
	bool "Temporary ARMv8-M protected Health Monitor verification"
	default n
	depends on HEALTH_MONITOR && ARCH_CHIP_MPS2_AN505 && APP_BINARY_SEPARATION && !SMP && DRIVERS_OS_API_TEST && SCHED_LPWORK
	---help---
		Test-only kernel observation and Binary Manager recovery commands,
		plus public-API tests in the app1/app2 user binaries.
```

## apps/examples/health_monitor_qemu/Kconfig
```kconfig
config EXAMPLES_HEALTH_MONITOR_QEMU
	bool "Temporary QEMU Health Monitor verification"
	default n
	depends on HEALTH_MONITOR && BUILD_FLAT && (ARCH_CHIP_LM3S6965 || ARCH_CHIP_MPS2_AN505) && !SMP && !DISABLE_PTHREAD
	---help---
		Test-only real-kernel API and lifecycle scenarios plus controlled-time
		system-timer probes. Do not enable in a product firmware.

config QEMU_HEALTH_MONITOR_CAPACITY
	int "Temporary Health Monitor heap capacity"
	default MAX_TASKS
	range 1 MAX_TASKS
	depends on EXAMPLES_HEALTH_MONITOR_QEMU
```

## apps/examples/ltp/Kconfig
```kconfig
#
# For a description of the syntax of this configuration file,
# see kconfig-language at https://www.kernel.org/doc/Documentation/kbuild/kconfig-language.txt
#

config EXAMPLES_LTP
	bool "Linux Test Project (LTP) tests"
	default n
	---help---
		Enable the Linux Test Project (LTP) POSIX conformance tests.
		LTP is a comprehensive test suite for validating POSIX
		conformance and system functionality. This port integrates
		a subset of LTP (version 20230516) for TizenRT.

if EXAMPLES_LTP

config EXAMPLES_LTP_STACKSIZE
	int "LTP test stack size"
	default 8192
	---help---
		Stack size for LTP test tasks. Increase for complex tests
		that use deep call chains or large local variables.

config EXAMPLES_LTP_PRIORITY
	int "LTP test task priority"
	default 100
	---help---
		Priority for LTP test tasks.

endif # EXAMPLES_LTP
```

## apps/examples/nuttx_mm_test/Kconfig
```kconfig
config EXAMPLES_NUTTX_MM_TEST
	bool "NuttX 12.13.0 allocator integration verification"
	default n
	depends on MM_NUTTX && BUILD_FLAT && !DISABLE_PTHREAD && BUILTIN_APPS
	depends on KMM_NHEAPS > 1
	---help---
		Register nuttx_mm_test in TASH. Verify the selected NuttX backend,
		public allocation, alignment/reallocation, per-heap ownership,
		failure preservation and bounded concurrent fragmentation.
		This is a verification example, not a product startup task.

config EXAMPLES_NUTTX_MM_LIFECYCLE
	bool "NuttX protected app heap lifecycle verification"
	default n
	depends on MM_NUTTX && BUILD_PROTECTED && APP_BINARY_SEPARATION
	depends on BINARY_MANAGER && SUPPORT_COMMON_BINARY && EXAMPLES_LOADABLE
	depends on NUM_APPS > 1 && !DISABLE_PTHREAD && BUILTIN_APPS
	depends on !BINMGR_RECOVERY && !OPTIMIZE_APP_RELOAD_TIME && !XIP_ELF
	select DRIVERS_OS_API_TEST
	---help---
		Register nuttx_mm_lifecycle in TASH and replace the app2 sample
		with a bounded allocator workload that returns normally. Reload
		app2 three times and verify heap, mutex and deferred-free cleanup.
		Intended for QEMU loadable_all and loadable_apps verification.
```

## apps/examples/performance/heap/Kconfig
```kconfig
#
# For a description of the syntax of this configuration file,
# see kconfig-language at https://www.kernel.org/doc/Documentation/kbuild/kconfig-language.txt
#

config EXAMPLES_HEAP_PERFORMANCE_TEST
	bool "Heap performance test"
	depends on !DISABLE_PTHREAD
	select CLOCK_MONOTONIC
	select LIBC_LONG_LONG
	default n
	---help---
		Measure allocation/free batch timings and task competition on one shared heap.

config USER_ENTRYPOINT
	string
	default "heaptest_main" if ENTRY_HEAP_PERFORMANCE_TEST
```

## apps/examples/testcase/le_tc/kernel/Kconfig
```kconfig
#
# For a description of the syntax of this configuration file,
# see kconfig-language at https://www.kernel.org/doc/Documentation/kbuild/kconfig-language.txt
#

menuconfig EXAMPLES_TESTCASE_KERNEL
	bool "Kernel TestCase Example"
	default y
	select DRIVERS_OS_API_TEST
	---help---
		Enable the Kernel TestCase Example

if EXAMPLES_TESTCASE_KERNEL
config DEBUG_TC_KN
	bool "Kernel Testcase Debug Output"
	default n
	depends on DEBUG

config TC_KN_ALL
	bool "All"
	default y
	select TC_KERNEL_BINFMT if BINFMT_ENABLE
	select TC_KERNEL_BINARY_MANAGER if BINARY_MANAGER
	select TC_KERNEL_CLOCK
	select TC_KERNEL_ENVIRON if !DISABLE_ENVIRON
	select TC_KERNEL_ERRNO
	select TC_KERNEL_GROUP if SCHED_HAVE_PARENT && SCHED_CHILD_STATUS
	select TC_KERNEL_LIBC_FIXEDMATH if LIBM
	select TC_KERNEL_LOG_DUMP if LOG_DUMP
	select TC_KERNEL_LIBC_INTTYPES
	select TC_KERNEL_LIBC_LIBGEN
	select TC_KERNEL_LIBC_MATH if LIBM
	select TC_KERNEL_LIBC_MISC
	select TC_KERNEL_LIBC_PTHREAD if !DISABLE_PTHREAD
	select TC_KERNEL_LIBC_QUEUE
	select TC_KERNEL_LIBC_SCHED
	select TC_KERNEL_LIBC_SEMAPHORE
	select TC_KERNEL_LIBC_SIGNAL if !DISABLE_SIGNALS && !DISABLE_POSIX_TIMERS
	select TC_KERNEL_LIBC_STDIO
	select TC_KERNEL_LIBC_STDLIB
	select TC_KERNEL_LIBC_STRING
	select TC_KERNEL_LIBC_SYSLOG
	select TC_KERNEL_LIBC_TIMER
	select TC_KERNEL_LIBC_UNISTD
	select TC_KERNEL_MQUEUE if !DISABLE_MQUEUE
	select TC_KERNEL_NET_PBUF if NET_LWIP
	select TC_KERNEL_PIPE if PIPES
	select TC_KERNEL_PM if PM
	select TC_KERNEL_PROCFS if FS_PROCFS && !FS_PROCFS_EXCLUDE_UPTIME && !FS_PROCFS_EXCLUDE_VERSION
	select TC_KERNEL_PTHREAD if !DISABLE_PTHREAD
	select TC_KERNEL_RTC if RTC_DRIVER
	select TC_KERNEL_SCHED
	select TC_KERNEL_SEMAPHORE
	select TC_KERNEL_SIGNAL if !DISABLE_SIGNALS
	select TC_KERNEL_SYSTEM_DEBUG if DEBUG_SYSTEM
	select TC_KERNEL_TASK
	select TC_KERNEL_TIMER if !DISABLE_POSIX_TIMERS
	select TC_KERNEL_VFS
	select TC_KERNEL_WDOG if WATCHDOG
	select TC_KERNEL_UMM_HEAP if MM_KERNEL_HEAP
	select TC_KERNEL_WORK_QUEUE if SCHED_WORKQUEUE && (SCHED_HPWORK || SCHED_LPWORK)
	select TC_KERNEL_IRQ
	select TC_KERNEL_MEM_LEAK_CHECKER if MEM_LEAK_CHECKER
	select TC_KERNEL_REBOOT_REASON if SYSTEM_REBOOT_REASON
	select ITC_KERNEL_ENVIRON if !DISABLE_ENVIRON
	select ITC_KERNEL_LIBC_PTHREAD if !DISABLE_PTHREAD
	select ITC_KERNEL_LIBC_SEMAPHORE
	select ITC_KERNEL_SEMAPHORE
	select ITC_KERNEL_SCHED
	select ITC_KERNEL_TIMER if !DISABLE_POSIX_TIMERS
	select ITC_KERNEL_PTHREAD if !DISABLE_PTHREAD

config TC_KERNEL_CLOCK
	bool "Clock"
	default n

config TC_KERNEL_BINFMT
	bool "Binfmt"
	default n
	depends on BINFMT_ENABLE

config TC_KERNEL_BINARY_MANAGER
	bool "Binary Manager"
	default n
	depends on BINARY_MANAGER

config TC_KERNEL_ENVIRON
	bool "Environ"
	default n
	depends on !DISABLE_ENVIRON

config TC_KERNEL_ERRNO
	bool "Errno"
	default n

config TC_KERNEL_GROUP
	bool "Group"
	default n
	depends on SCHED_HAVE_PARENT
	depends on SCHED_CHILD_STATUS

config TC_KERNEL_LOG_DUMP
	bool "Log Dump"
	default n
	depends on LOG_DUMP

config TC_KERNEL_LIBC_FIXEDMATH
	bool "Libc FixedMath"
	default n
	depends on LIBM

config TC_KERNEL_LIBC_INTTYPES
	bool "Libc Inttypes"
	default n

config TC_KERNEL_LIBC_LIBGEN
	bool "Libc Libgen"
	default n

config TC_KERNEL_LIBC_MATH
	bool "Libc Math"
	default n
	depends on LIBM

config TC_KERNEL_LIBC_MISC
	bool "Libc Misc"
	default n

config TC_KERNEL_LIBC_PTHREAD
	bool "Libc Pthread"
	default n
	depends on !DISABLE_PTHREAD
	select MUTEX_TYPES

config TC_KERNEL_LIBC_QUEUE
	bool "Libc Queue"
	default n

config TC_KERNEL_LIBC_SCHED
	bool "Libc Sched"
	default n

config TC_KERNEL_LIBC_SEMAPHORE
	bool "Libc Semaphore"
	default n

config TC_KERNEL_LIBC_SIGNAL
	bool "Libc Signal"
	default n
	depends on !DISABLE_SIGNALS
	depends on !DISABLE_POSIX_TIMERS

config TC_KERNEL_LIBC_STDIO
	bool "Libc Stdio"
	default n

config TC_KERNEL_LIBC_STDLIB
	bool "Libc Stdlib"
	default n

config TC_KERNEL_LIBC_STRING
	bool "Libc String"
	default n

config TC_KERNEL_LIBC_TIMER
	bool "Libc Timer"
	default n

config TC_KERNEL_LIBC_UNISTD
	bool "Libc Unistd"
	default n

config TC_KERNEL_LIBC_SYSLOG
	bool "Libc Syslog"
	default n

config TC_KERNEL_MQUEUE
	bool "Mqueue"
	default n
	depends on !DISABLE_MQUEUE

config TC_KERNEL_NET_PBUF
	bool "Net Pbuf"
	default n
	depends on NET_LWIP

config TC_KERNEL_PIPE
	bool "Pipe"
	default n
	depends on PIPES

config TC_KERNEL_PM
	bool "PM"
	default n
	depends on PM

config TC_KERNEL_PROCFS
	bool "ProcFS"
	default n
	depends on FS_PROCFS
	depends on !FS_PROCFS_EXCLUDE_UPTIME
	depends on !FS_PROCFS_EXCLUDE_VERSION

config TC_KERNEL_PTHREAD
	bool "Pthread"
	default n
	depends on !DISABLE_PTHREAD
	select MUTEX_TYPES

config TC_KERNEL_RTC
	bool "RTC"
	default n
	depends on RTC_DRIVER

config TC_KERNEL_SCHED
	bool "Sched"
	default n
#	select SCHED_HAVE_PARENT

config TC_KERNEL_SEMAPHORE
	bool "Semaphore"
	default n

config TC_KERNEL_SIGNAL
	bool "Signal"
	default n
	depends on !DISABLE_SIGNALS

config TC_KERNEL_SYSTEM_DEBUG
	bool "System Debug"
	default n
	depends on DEBUG_SYSTEM

config TC_KERNEL_TASK
	bool "Task"
	default n
	select SCHED_STARTHOOK

config TC_KERNEL_TERMIOS
	bool "Termios"
	default n
	depends on SERIAL_TERMIOS

config TC_KERNEL_TIMER
	bool "Timer"
	default n
	depends on !DISABLE_POSIX_TIMERS

config TC_KERNEL_VFS
	bool "VFS"
	default n

config TC_KERNEL_WDOG
	bool "Wdog"
	default n
	depends on WATCHDOG

config TC_KERNEL_UMM_HEAP
	bool "Umm Heap"
	default n
	depends on MM_KERNEL_HEAP

config TC_KERNEL_TASH_HEAPINFO
	bool "Heapinfo"
	default n

config TC_KERNEL_TASH_STACKMONITOR
	bool "StackMonitor"
	default n

config TC_KERNEL_WORK_QUEUE
	bool "wqueue"
	default n
	depends on SCHED_WORKQUEUE
	depends on SCHED_HPWORK || SCHED_LPWORK

config TC_KERNEL_MEMORY_SAFETY
	bool "Memory Safety"
	default n
	depends on !DISABLE_MQUEUE
	depends on !DISABLE_PTHREAD

config TC_KERNEL_IRQ
	bool "irq"
	default n

config TC_KERNEL_MEM_LEAK_CHECKER
	bool "Mem Leak Checker"
	default n
	depends on MEM_LEAK_CHECKER

config TC_KERNEL_REBOOT_REASON
	bool "Reboot Reason"
	default n
	depends on SYSTEM_REBOOT_REASON

config ITC_KERNEL_ENVIRON
	bool "ITC Environ"
	default n
	depends on !DISABLE_ENVIRON

if ITC_KERNEL_ENVIRON
config ITC_ENV_LOOP_SIZE
	int "Iterator Count"
	default 100
endif

config ITC_KERNEL_LIBC_PTHREAD
	bool "ITC libc Pthread"
	default n
	depends on !DISABLE_PTHREAD
if ITC_KERNEL_LIBC_PTHREAD
config ITC_LIBC_PTHREAD_LOOP_SIZE
	int "Iterator Count"
	default 100
endif

config ITC_KERNEL_LIBC_SEMAPHORE
	bool "ITC Libc Semaphore"
	default n

config ITC_KERNEL_SEMAPHORE
	bool "ITC Semaphore"
	default n
if ITC_KERNEL_SEMAPHORE
config ITC_KERN_SEM_LOOP_SIZE
	int "Iterator Count"
	default 100
endif

config ITC_KERNEL_SCHED
	bool "ITC Sched"
	default n

config ITC_KERNEL_TIMER
	bool "ITC Timer"
	default n
	depends on !DISABLE_POSIX_TIMERS

config ITC_KERNEL_PTHREAD
	bool "ITC Pthread"
	default n
	depends on !DISABLE_PTHREAD
	select MUTEX_TYPES
if ITC_KERNEL_PTHREAD
config ITC_KERN_PTHREAD_LOOP_SIZE
	int "Iterator Count"
	default 100
endif


endif #EXAMPLES_TESTCASE_KERNEL
```

## apps/examples/testcase/ostest/Kconfig
```kconfig
#
# For a description of the syntax of this configuration file,
# see kconfig-language at https://www.kernel.org/doc/Documentation/kbuild/kconfig-language.txt
#

config TESTING_OSTEST
	bool "NuttX OS test example"
	default n
	---help---
		Enable the Apache NuttX ostest port as the "ostest" TASH command.

if TESTING_OSTEST

config TESTING_OSTEST_LOOPS
	int "OS test loop count"
	default 1
	---help---
		Number of executions.  Zero runs the test forever.

config TESTING_OSTEST_STACKSIZE
	int "OS test stack size"
	default 8192
	---help---
		Stack size used by the ostest command and its main test task.

config TESTING_OSTEST_NBARRIER_THREADS
	int "Number of barrier threads"
	default 8
	---help---
		Number of threads created by the barrier test.

config TESTING_OSTEST_AIO
	bool "Asynchronous I/O tests"
	default n
	depends on FS_AIO

if TESTING_OSTEST_AIO

config TESTING_OSTEST_AIOPATH
	string "AIO scratch path"
	default "/tmp"

endif

config TESTING_OSTEST_RR_RANGE
	int "Round-robin test end of search range"
	default 30000
	range 1 32767

config TESTING_OSTEST_RR_RUNS
	int "Round-robin test number of runs"
	default 10
	range 1 32767

if ARCH_FPU && SCHED_WAITPID

config TESTING_OSTEST_FPUTESTDISABLE
	bool "Disable FPU test"
	default n

if !TESTING_OSTEST_FPUTESTDISABLE

config TESTING_OSTEST_FPULOOPS
	int "Number of FPU test loops"
	default 16

config TESTING_OSTEST_FPUMSDELAY
	int "FPU test delay in milliseconds"
	default 750

config TESTING_OSTEST_FPUPRIORITY
	int "FPU test thread priority"
	default 100

config TESTING_OSTEST_FPUSTACKSIZE
	int "FPU test thread stack size"
	default 2048

endif
endif

config TESTING_OSTEST_WAITRESULT
	bool "Wait for and return the test result"
	default y
	depends on SCHED_WAITPID

endif
```

## apps/system/mem_leak_checker/Kconfig
```kconfig
#
# For a description of the syntax of this configuration file,
# see kconfig-language at https://www.kernel.org/doc/Documentation/kbuild/kconfig-language.txt
#

config MEM_LEAK_CHECKER
	bool "Memory Leak Checker"
	default n
	depends on DEBUG_MM_HEAPINFO
	select SAVE_BIN_SECTION_ADDR if APP_BINARY_SEPARATION
	---help---
		Enable support for Memory Leak Checker. This requires arch/arm/src/<chip>/memory_region.h to work for the selected board.

if MEM_LEAK_CHECKER

config MEM_LEAK_CHECKER_HASH_TABLE_SIZE
	int "size of hash table"
	range 1 65536
	default 1007
	---help---
		The size of the hash table for searching. It is preferred to have this as a prime number

config MEM_LEAK_CHECKER_MAX_ALLOC_COUNT
	int "max allocation counts"
	range 1 65536
	default 3000
	---help---
		It must be larger than the total number of memory allocations.

config MEM_LEAK_REMOTE_PAUSED_MAX_POLLS
	int "maximum remote CPU paused-service polls"
	range 1 65536
	default 65536
	---help---
		Bound every remote CPU service iteration while a leak-check snapshot
		owns the CPU.  Exhaustion is a fatal ownership failure, not a timeout
		that permits a normal leak verdict.

config MEM_LEAK_CHECKER_REGISTRY_ENUM_MAX
	int "registry enumeration operation maximum"
	range 1 65536
	default 65536
config MEM_LEAK_CHECKER_DOMAIN_PIN_MAX
	int "domain pin operation maximum"
	range 1 65536
	default 65536
config MEM_LEAK_CHECKER_ROOT_CONTAINER_ENUM_MAX
	int "root-container enumeration operation maximum"
	range 1 65536
	default 65536
config MEM_LEAK_CHECKER_HEAP_ACQUIRE_MAX
	int "heap acquisition operation maximum"
	range 1 65536
	default 65536
config MEM_LEAK_CHECKER_HEAP_RELEASE_VALIDATE_MAX
	int "heap release validation operation maximum"
	range 1 65536
	default 65536
config MEM_LEAK_CHECKER_DOMAIN_UNPIN_MAX
	int "domain unpin operation maximum"
	range 1 65536
	default 65536
config MEM_LEAK_CHECKER_REGISTRY_UNWIND_MAX
	int "registry unwind operation maximum"
	range 1 65536
	default 65536
config MEM_LEAK_CHECKER_PAUSE_ACK_MAX
	int "pause acknowledgement operation maximum"
	range 1 65536
	default 65536
config MEM_LEAK_CHECKER_REMOTE_PAUSED_SERVICE_MAX
	int "remote paused service operation maximum"
	range 1 65536
	default 65536
config MEM_LEAK_CHECKER_CANCEL_COMPLETION_MAX
	int "cancel completion operation maximum"
	range 1 65536
	default 65536
config MEM_LEAK_CHECKER_RESUME_COMPLETION_MAX
	int "resume completion operation maximum"
	range 1 65536
	default 65536
config MEM_LEAK_CHECKER_SGI_DRAIN_MAX
	int "SGI drain operation maximum"
	range 1 65536
	default 65536

config TC_KERNEL_MEM_LEAK_CHECKER_FATAL
	bool "Enable deterministic memory-leak fatal markers"
	default n
	depends on TC_KERNEL_MEM_LEAK_CHECKER
	---help---
		Emit fixed low-level markers for fatal ownership tests.  This option
		never formats or allocates and is intended only for kernel test builds.

endif
```
