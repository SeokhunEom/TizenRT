## build/configs/qemu-armv8m/loadable_all/defconfig
```kconfig
#
# QEMU MPS2-AN505 loadable_all configuration with kernel_tc
#

#
# Build Setup
#
CONFIG_HOST_LINUX=y
# CONFIG_HOST_OSX is not set
# CONFIG_HOST_WINDOWS is not set
# CONFIG_WINDOWS_NATIVE is not set

#
# Build Configuration
#
CONFIG_APPS_DIR="../apps"
CONFIG_FRAMEWORK_DIR="../framework"
CONFIG_TOOLS_DIR="../tools"
# CONFIG_BUILD_FLAT is not set
CONFIG_BOARD_BUILD_DATE="260611"

#
# Binary Output Formats
#
# CONFIG_INTELHEX_BINARY is not set
CONFIG_RAW_BINARY=y

#
# Customize Header Files
#
CONFIG_ARCH_HAVE_CUSTOMOPT=y
# CONFIG_DEBUG_NOOPT is not set
CONFIG_DEBUG_FULLOPT=y

#
# Chip Selection
#
CONFIG_ARCH_ARM=y
CONFIG_ARCH="arm"
CONFIG_ARCH_CHIP_QEMU_ARMV8M=y
CONFIG_ARCH_CHIP="qemu-armv8m"

#
# ARM Options
#
CONFIG_ARCH_CORTEXM33=y
CONFIG_ARCH_ARMV8M_FAMILY=y
CONFIG_ARCH_FAMILY="armv8-m"
CONFIG_ARCH_HAVE_CMNVECTOR=y
CONFIG_ARM_CMNVECTOR=y
CONFIG_ARCH_HAVE_FPU=y
CONFIG_ARCH_HAVE_LAZYFPU=y
# CONFIG_ARCH_FPU is not set
CONFIG_ARCH_HAVE_MPU=y
CONFIG_ARM_MPU=y
CONFIG_ARMV8M_MPU=y
CONFIG_ARMV8M_MPU_NREGIONS=16

#
# Exception stack options
#
CONFIG_REG_STACK_OVERFLOW_PROTECTION=y
# CONFIG_STACK_OVERFLOW_PROTECTION_DISABLE is not set

#
# ARMV8M Configuration Options
#
CONFIG_ARMV8M_USEBASEPRI=y
CONFIG_ARMV8M_TOOLCHAIN_GNU_EABIL=y

#
# QEMU ARMv8-M Configuration Options
#
CONFIG_ARCH_CHIP_MPS2_AN505=y

#
# Architecture Options
#
CONFIG_ARCH_HAVE_IRQPRIO=y
CONFIG_ARCH_HAVE_VFORK=y
CONFIG_ARCH_HAVE_RESET=y
CONFIG_BOARD_INITIALIZE=y
CONFIG_ARCH_HAVE_RAMVECTORS=y
CONFIG_ARCH_HAVE_HIPRI_INTERRUPT=y
CONFIG_ARCH_HAVE_NESTED_INTERRUPT=y
CONFIG_ARCH_USE_MPU=y
CONFIG_ARCH_IRQPRIO=y
CONFIG_ARCH_STACKDUMP=y

#
# Board Settings
#
CONFIG_BOARD_LOOPSPERMSEC=20000

#
# Interrupt options
#
CONFIG_ARCH_HAVE_INTERRUPTSTACK=y
CONFIG_ARCH_INTERRUPTSTACK=0
CONFIG_ARCH_NESTED_IRQ_STACK_SIZE=512

#
# Boot options
#
CONFIG_BOOT_RUNFROMFLASH=y

#
# Boot Memory Configuration
#
CONFIG_RAM_KREGIONx_START="0x80000000,0x80400000,0x10380000,"
CONFIG_RAM_KREGIONx_SIZE="4194304,8388608,524288,"
CONFIG_RAM_KREGIONx_HEAP_INDEX="0,2,1,"

#
# Board Selection
#
CONFIG_ARCH_BOARD_QEMU_ARMV8M=y
CONFIG_ARCH_BOARD="qemu-armv8m"

#
# Common Board Options
#
CONFIG_BOARD_ASSERT_SYSTEM_HALT=y

#
# Kernel Features
#
CONFIG_DISABLE_OS_API=y
# CONFIG_DISABLE_POSIX_TIMERS is not set
# CONFIG_DISABLE_PTHREAD is not set
# CONFIG_DISABLE_SIGNALS is not set
# CONFIG_DISABLE_MQUEUE is not set
# CONFIG_DISABLE_ENVIRON is not set

#
# Clocks and Timers
#
CONFIG_USEC_PER_TICK=1000
CONFIG_SYSTEM_TIME64=y
CONFIG_CLOCK_MONOTONIC=y
CONFIG_START_YEAR=2026
CONFIG_START_MONTH=6
CONFIG_START_DAY=11
CONFIG_MAX_WDOGPARMS=2
CONFIG_PREALLOC_WDOGS=8
CONFIG_WDOG_INTRESERVE=0
CONFIG_PREALLOC_TIMERS=2

#
# Tasks and Scheduling
#
CONFIG_INIT_ENTRYPOINT=y
CONFIG_RR_INTERVAL=10
CONFIG_TASK_NAME_SIZE=31
CONFIG_MAX_TASKS=32
CONFIG_SCHED_HAVE_PARENT=y
CONFIG_SCHED_WAITPID=y
CONFIG_SIGKILL_HANDLER=y

#
# Pthread Options
#
CONFIG_PTHREAD_MUTEX_TYPES=y
# CONFIG_PTHREAD_MUTEX_ROBUST is not set
CONFIG_PTHREAD_MUTEX_UNSAFE=y
# CONFIG_PTHREAD_MUTEX_BOTH is not set
CONFIG_NPTHREAD_KEYS=4
CONFIG_NPTHREAD_DESTRUCTOR_ITERATIONS=4

#
# Files and I/O
#
CONFIG_DEV_CONSOLE=y
CONFIG_SDCLONE_DISABLE=y
CONFIG_UART_RXBUFSIZE=256
CONFIG_UART_TXBUFSIZE=1024
CONFIG_NFILE_DESCRIPTORS=32
CONFIG_NFILE_STREAMS=8
CONFIG_FS_TMPFS=y
CONFIG_FS_AUTOMOUNT_TMPFS=y
CONFIG_FS_TMPFS_BLOCKSIZE=512
CONFIG_FS_TMPFS_DIRECTORY_ALLOCGUARD=64
CONFIG_FS_TMPFS_DIRECTORY_FREEGUARD=128
CONFIG_FS_TMPFS_FILE_ALLOCGUARD=512
CONFIG_FS_TMPFS_FILE_FREEGUARD=1024
CONFIG_NAME_MAX=32
# CONFIG_PRIORITY_INHERITANCE is not set
CONFIG_SEM_PREALLOCHOLDERS=16
CONFIG_SEM_NNESTPRIO=16

#
# RTOS hooks
#
CONFIG_SCHED_ATEXIT=y
CONFIG_SCHED_ONEXIT=y

#
# Signal Numbers
#
CONFIG_SIG_SIGUSR1=1
CONFIG_SIG_SIGUSR2=2
CONFIG_SIG_SIGALARM=3
CONFIG_SIG_SIGCHLD=4
CONFIG_SIG_SIGCONDTIMEDOUT=16
CONFIG_SIG_SIGWORK=17

#
# POSIX Message Queue Options
#
CONFIG_PREALLOC_MQ_MSGS=32
CONFIG_MQ_MAXMSGSIZE=256

#
# Stack size information
#
CONFIG_IDLETHREAD_STACKSIZE=8192
CONFIG_USERMAIN_STACKSIZE=2048
CONFIG_PTHREAD_STACK_MIN=256
CONFIG_PTHREAD_STACK_DEFAULT=2048

#
# Device Drivers
#
# CONFIG_DISABLE_POLL is not set
CONFIG_DEV_NULL=y
CONFIG_DEV_URANDOM=y
CONFIG_DEV_URANDOM_XORSHIFT128=y
CONFIG_DEV_ZERO=y
CONFIG_DRIVERS_OS_API_TEST=y
CONFIG_NETDEVICES=y
CONFIG_MMINFO=y
CONFIG_PIPES=y
CONFIG_DEV_PIPE_SIZE=1024
CONFIG_SERIAL=y
CONFIG_SERIAL_CONSOLE=y
CONFIG_ARCH_HAVE_UART0=y
CONFIG_MCU_SERIAL=y
CONFIG_STANDARD_SERIAL=y
CONFIG_SERIAL_NPOLLWAITERS=2
CONFIG_ARCH_HAVE_SERIAL_TERMIOS=y
CONFIG_SERIAL_TERMIOS=y
CONFIG_UART0_SERIAL_CONSOLE=y
CONFIG_UART0_RXBUFSIZE=1024
CONFIG_UART0_TXBUFSIZE=4096
CONFIG_UART0_BAUD=1000000
CONFIG_UART0_BITS=8
CONFIG_UART0_PARITY=0
CONFIG_UART0_2STOP=0

#
# Networking Support
#
CONFIG_ARCH_HAVE_NET=y
CONFIG_NET=y
CONFIG_NET_LWIP=y
CONFIG_NET_IPv4=y
CONFIG_NET_IP_OPTIONS_ALLOWED=y
CONFIG_NET_IP_FRAG=y
CONFIG_NET_IP_REASSEMBLY=y
CONFIG_NET_ICMP=y
CONFIG_NET_LWIP_IGMP=y
CONFIG_NET_ARP=y
CONFIG_NET_ARP_TABLESIZE=10
CONFIG_NET_ARP_QUEUEING=y
CONFIG_NET_ETHARP_TRUST_IP_MAC=y
CONFIG_NET_ARP_STATIC_ENTRIES=y
CONFIG_NET_UDP=y
CONFIG_NET_TCP=y
CONFIG_NET_TCP_QUEUE_OOSEQ=y
CONFIG_NET_TCP_CALCULATE_EFF_SEND_MSS=y
CONFIG_NET_IPv6=y
CONFIG_NET_IPv6_NUM_ADDRESSES=3
CONFIG_NET_IPv6_REASS=y
CONFIG_NET_IPV6_REASS_MAXAGE=60
CONFIG_NET_IPv6_SEND_ROUTER_SOLICIT=y
CONFIG_NET_IPv6_AUTOCONFIG=y
CONFIG_NET_IPv6_DUP_DETECT_ATTEMPTS=1
CONFIG_NET_IPv6_ND=y
CONFIG_NET_IPv6_ND_QUEUEING=y
CONFIG_NET_IPv6_ND_QUEUE=20
CONFIG_NET_IPv6_ND_NUM_NEIGHBORS=10
CONFIG_NET_IPv6_ND_NUM_DESTINATIONS=10
CONFIG_NET_IPv6_ND_NUM_PREFIXES=5
CONFIG_NET_IPv6_ND_NUM_ROUTERS=3
CONFIG_NET_IPv6_ND_MAX_MULTICAST_SOLICIT=3
CONFIG_NET_IPv6_ND_MAX_UNICAST_SOLICIT=3
CONFIG_NET_IPv6_ND_MAX_SOLICIT_INTERVAL=4000
CONFIG_NET_IPv6_ND_REACHABLE_TIME=30000
CONFIG_NET_IPv6_ND_RETRANS_TIMER=1005
CONFIG_NET_IPv6_ND_DELAY_FIRST_PROBE_TIME=5000
CONFIG_NET_IPv6_ND_ALLOW_RA_UPDATES=y
CONFIG_NET_IPv6_ND_TCP_REACHABILITY_HINTS=y
CONFIG_NET_IPv6_ND_RDNSS_MAX_DNS_SERVERS=0
CONFIG_NET_IPv6_ICMP=y
CONFIG_NET_IPv6_ICMP_DATASIZE=8
CONFIG_NET_IPv6_ICMP_HL=255
CONFIG_NET_IPv6_MLD=y
CONFIG_NET_IPv6_MLD_GROUP=4
CONFIG_NET_SOCKET=y
CONFIG_NBSDSOCKET_DESCRIPTORS=20
CONFIG_NET_TCP_KEEPALIVE=y
CONFIG_NET_RAW=y
CONFIG_NET_SO_SNDTIMEO=y
CONFIG_NET_SO_RCVTIMEO=y
CONFIG_NET_SO_RCVBUF=y
CONFIG_NET_SO_REUSE=y
CONFIG_NET_TCPIP_MBOX_SIZE=64
CONFIG_NET_DEFAULT_ACCEPTMBOX_SIZE=64
CONFIG_NET_DEFAULT_RAW_RECVMBOX_SIZE=64
CONFIG_NET_DEFAULT_TCP_RECVMBOX_SIZE=64
CONFIG_NET_DEFAULT_UDP_RECVMBOX_SIZE=64
CONFIG_NET_MEM_ALIGNMENT=4
CONFIG_NET_MEMP_MEM_MALLOC=y
CONFIG_NET_MEM_SIZE=153600
CONFIG_NET_PBUF_LINK_ENCAPSULATION_HLEN=96
CONFIG_NET_TCPIP_THREAD_PRIO=110
CONFIG_NET_TCPIP_THREAD_STACKSIZE=8192
CONFIG_NET_COMPAT_MUTEX=y
CONFIG_NET_SYS_LIGHTWEIGHT_PROT=y
CONFIG_NET_STATS=y
CONFIG_NET_LWIP_NETDB=y
CONFIG_NET_DNS_TABLE_SIZE=4
CONFIG_NET_DNS_MAX_NAME_LENGTH=256
CONFIG_NET_DNS_MAX_SERVERS=3
CONFIG_NET_LWIP_SINGLE_PBUF=y
CONFIG_NET_ETH_MTU=1500
CONFIG_NET_ETHERNET=y
CONFIG_NET_LWIP_DHCP=y
CONFIG_NETUTILS_DHCPC=y
CONFIG_LWIP_DHCPC=y
CONFIG_LWIP_DHCPC_TIMEOUT=10000
CONFIG_NETUTILS_NETLIB=y
CONFIG_NET_NETMON=y
CONFIG_NETUTILS_STATS_DISPLAY_TOOL=y
CONFIG_NET_NETMGR=y
# CONFIG_NET_NETMGR_ZEROCOPY is not set
CONFIG_NET_LOOPBACK_INTERFACE=y

#
# File Systems
#
CONFIG_FS_READABLE=y
CONFIG_FS_WRITABLE=y
CONFIG_FS_MQUEUE_MPATH="/var/mqueue"
CONFIG_FS_PROCFS=y

#
# System Logging
#
# CONFIG_SYSLOG is not set

#
# Memory Management
#
CONFIG_MM_KERNEL_HEAP=y
CONFIG_KMM_REGIONS=3
CONFIG_KMM_NHEAPS=3
CONFIG_MM_ASSERT_ON_FAIL=y

#
# Work Queue Support
#
CONFIG_SCHED_WORKQUEUE=y
CONFIG_SCHED_HPWORK=y
CONFIG_SCHED_HPWORKPRIORITY=201
CONFIG_SCHED_HPWORKSTACKSIZE=2048
CONFIG_SCHED_LPWORK=y
CONFIG_SCHED_LPNTHREADS=1
CONFIG_SCHED_LPWORKPRIORITY=50
CONFIG_SCHED_LPWORKPRIOMAX=176
CONFIG_SCHED_LPWORKSTACKSIZE=2048

#
# Debug Options
#
CONFIG_DEBUG=y
CONFIG_DEBUG_ERROR=y
CONFIG_DEBUG_VERBOSE=y
CONFIG_DEBUG_MM=y
CONFIG_DEBUG_MM_HEAPINFO=y
CONFIG_DEBUG_SYMBOLS=y
CONFIG_ARCH_HAVE_STACKCHECK=y
CONFIG_STACK_COLORATION=y

#
# Standard C Library Options
#
CONFIG_STDIO_BUFFER_SIZE=64
CONFIG_STDIO_LINEBUFFER=y
CONFIG_NUNGET_CHARS=2
CONFIG_LIB_HOMEDIR="/"
CONFIG_LIBM=y
CONFIG_LIBC_FLOATINGPOINT=y
CONFIG_LIBC_LONG_LONG=y
CONFIG_LIBC_FLOATPRECISION=6
CONFIG_LIBC_SCANSET=y
CONFIG_LIB_RAND_ORDER=1
CONFIG_EOL_IS_EITHER_CRLF=y
CONFIG_LIBC_STRERROR=y
CONFIG_LIBC_TMPDIR="/tmp"
CONFIG_LIBC_MAX_TMPFILE=32
CONFIG_LIBC_ARCH_ELF=y
CONFIG_LIBC_EXECFUNCS=y
CONFIG_LIBC_SYMTAB=y
CONFIG_ARCH_LOWPUTC=y
CONFIG_LIB_SENDFILE_BUFSIZE=512

#
# Application Configuration
#
CONFIG_ENTRY_HELLO=y
CONFIG_USER_ENTRYPOINT="hello_main"
CONFIG_BUILTIN_APPS=y

#
# Examples
#
CONFIG_EXAMPLES_TESTCASE=y
CONFIG_EXAMPLES_TESTCASE_NETWORK=y
CONFIG_TC_NET_SOCKET=y
CONFIG_TC_NET_SOCKET_SHARE=y
CONFIG_TC_NET_PBUF=y
CONFIG_TC_NET_SETSOCKOPT=y
CONFIG_TC_NET_CONNECT=y
CONFIG_TC_NET_CLOSE=y
CONFIG_TC_NET_BIND=y
CONFIG_TC_NET_LISTEN=y
CONFIG_TC_NET_GETSOCKNAME=y
CONFIG_TC_NET_GETSOCKOPT=y
CONFIG_TC_NET_FCNTL=y
CONFIG_TC_NET_IOCTL=y
CONFIG_TC_NET_ACCEPT=y
CONFIG_TC_NET_SEND=y
CONFIG_TC_NET_RECV=y
CONFIG_TC_NET_GETPEERNAME=y
CONFIG_TC_NET_SENDTO=y
CONFIG_TC_NET_RECVFROM=y
CONFIG_TC_NET_SHUTDOWN=y
CONFIG_TC_NET_DHCPC=y
CONFIG_TC_NET_INET=y
CONFIG_TC_NET_ETHER=y
CONFIG_TC_NET_NETDB=y
CONFIG_ITC_NET_CLOSE=y
CONFIG_ITC_NET_LISTEN=y
CONFIG_ITC_NET_SETSOCKOPT=y
CONFIG_ITC_NET_SEND=y
CONFIG_ITC_NET_INET=y
CONFIG_ITC_NET_NETDB=y
CONFIG_ITC_NET_CONNECT=y
CONFIG_EXAMPLES_TESTCASE_KERNEL=y
CONFIG_TC_KN_ALL=y
CONFIG_TC_KERNEL_CLOCK=y
CONFIG_TC_KERNEL_ENVIRON=y
CONFIG_TC_KERNEL_ERRNO=y
CONFIG_TC_KERNEL_LIBC_FIXEDMATH=y
CONFIG_TC_KERNEL_LIBC_INTTYPES=y
CONFIG_TC_KERNEL_LIBC_LIBGEN=y
CONFIG_TC_KERNEL_LIBC_MATH=y
CONFIG_TC_KERNEL_LIBC_MISC=y
CONFIG_TC_KERNEL_LIBC_PTHREAD=y
CONFIG_TC_KERNEL_LIBC_QUEUE=y
CONFIG_TC_KERNEL_LIBC_SCHED=y
CONFIG_TC_KERNEL_LIBC_SEMAPHORE=y
CONFIG_TC_KERNEL_LIBC_STDIO=y
CONFIG_TC_KERNEL_LIBC_STDLIB=y
CONFIG_TC_KERNEL_LIBC_STRING=y
CONFIG_TC_KERNEL_LIBC_TIMER=y
CONFIG_TC_KERNEL_LIBC_UNISTD=y
CONFIG_TC_KERNEL_LIBC_SYSLOG=y
CONFIG_TC_KERNEL_MQUEUE=y
CONFIG_TC_KERNEL_LIBC_SIGNAL=y
CONFIG_TC_KERNEL_PTHREAD=y
CONFIG_TC_KERNEL_SCHED=y
CONFIG_TC_KERNEL_SEMAPHORE=y
CONFIG_TC_KERNEL_SIGNAL=y
# CONFIG_TC_KERNEL_SYSTEM_DEBUG is not set
CONFIG_TC_KERNEL_TASK=y
CONFIG_TC_KERNEL_TERMIOS=y
CONFIG_TC_KERNEL_TIMER=y
CONFIG_TC_KERNEL_UMM_HEAP=y
CONFIG_TC_KERNEL_TASH_HEAPINFO=y
# CONFIG_TC_KERNEL_TASH_STACKMONITOR is not set
CONFIG_TC_KERNEL_WORK_QUEUE=y
# CONFIG_TC_KERNEL_MEMORY_SAFETY is not set
CONFIG_ITC_KERNEL_ENVIRON=y
CONFIG_ITC_ENV_LOOP_SIZE=100
CONFIG_ITC_KERNEL_LIBC_PTHREAD=y
CONFIG_ITC_LIBC_PTHREAD_LOOP_SIZE=100
CONFIG_ITC_KERNEL_LIBC_SEMAPHORE=y
CONFIG_ITC_KERNEL_SEMAPHORE=y
CONFIG_ITC_KERN_SEM_LOOP_SIZE=100
CONFIG_ITC_KERNEL_SCHED=y
CONFIG_ITC_KERNEL_TIMER=y
CONFIG_ITC_KERNEL_PTHREAD=y
CONFIG_ITC_KERN_PTHREAD_LOOP_SIZE=100

#
# Shell
#
CONFIG_TASH=y
CONFIG_TASH_TASK_PRIORITY=125
CONFIG_TASH_MAX_STORE_COMMANDS=10
CONFIG_TASH_REBOOT=y
CONFIG_TASH_CMDTASK_STACKSIZE=4096
CONFIG_TASH_CMDTASK_PRIORITY=100
CONFIG_LIB_BOARDCTL=y
CONFIG_BOARDCTL_RESET=y

#
# System Libraries and Add-Ons
#
CONFIG_SYSTEM_PREAPP_INIT=y
CONFIG_SYSTEM_PREAPP_STACKSIZE=2048
CONFIG_SYSTEM_READLINE=y
CONFIG_READLINE_ECHO=y
CONFIG_SYSTEM_INFORMATION=y
CONFIG_SYSTEM_CMDS=y
CONFIG_SYSTEM_NETDB=y
CONFIG_SYSTEM_NETDB_STACKSIZE=2048
CONFIG_SYSTEM_NETDB_PRIORITY=100
CONFIG_NET_CMDS=y
CONFIG_NET_PING_CMD=y
CONFIG_NET_PING_CMD_ICOUNT=3
CONFIG_FS_CMDS=y
CONFIG_FSCMD_BUFFER_LEN=256
CONFIG_ENABLE_DATE=y
CONFIG_ENABLE_ENV_GET=y
CONFIG_ENABLE_ENV_SET=y
CONFIG_ENABLE_ENV_UNSET=y
CONFIG_ENABLE_FREE=y
CONFIG_ENABLE_HEAPINFO=y
CONFIG_ENABLE_KILL=y
CONFIG_ENABLE_KILLALL=y
CONFIG_ENABLE_PS=y
CONFIG_ENABLE_UPTIME=y

#
# Runtime Environment
#
# CONFIG_ENABLE_IOTJS is not set
CONFIG_APP_BINARY_SEPARATION=y
CONFIG_NUM_APPS=2
CONFIG_SUPPORT_COMMON_BINARY=y
CONFIG_COMMON_BINARY_VERSION="260611"
CONFIG_COMMON_BINARY_NAME="common"
CONFIG_COMMON_BIN_STATIC_RAMSIZE=524288
CONFIG_BUILD_PROTECTED=y
CONFIG_BUILD_2PASS=y
CONFIG_PASS1_TARGET="all"
CONFIG_PASS1_OBJECT=""
CONFIG_LIB_SYSCALL=y
CONFIG_SYS_RESERVED=8
CONFIG_BINFMT_ENABLE=y
CONFIG_BINFMT_LOADABLE=y
CONFIG_BINFMT_SECTION_UNIFIED_MEMORY=y
CONFIG_ELF_ALIGN_LOG2=2
CONFIG_ELF_STACKSIZE=2048
CONFIG_ELF_BUFFERSIZE=32
CONFIG_ELF_BUFFERINCR=32
CONFIG_ELF_EXCLUDE_SYMBOLS=y
# CONFIG_ELF_CACHE_READ is not set
CONFIG_HEAP_INDEX_LOADED_APP=2
CONFIG_RAM_MALLOC_PRIOR_INDEX=0
CONFIG_APP1_INFO=y
CONFIG_APP1_BIN_NAME="app1"
CONFIG_APP1_BIN_TYPE="ELF"
CONFIG_APP1_BIN_VER=260611
CONFIG_APP1_BIN_DYN_RAMSIZE=512000
CONFIG_APP1_BIN_LOADING_PRIORITY="LOW"
CONFIG_APP1_MAIN_STACKSIZE=8192
CONFIG_APP1_MAIN_PRIORITY=180
CONFIG_APP2_INFO=y
CONFIG_APP2_BIN_NAME="app2"
CONFIG_APP2_BIN_TYPE="ELF"
CONFIG_APP2_BIN_VER=260611
CONFIG_APP2_BIN_DYN_RAMSIZE=512000
CONFIG_APP2_BIN_LOADING_PRIORITY="HIGH"
CONFIG_APP2_MAIN_STACKSIZE=8192
CONFIG_APP2_MAIN_PRIORITY=180
CONFIG_BM_PRIORITY_MIN=200
CONFIG_BM_PRIORITY_MAX=205
# CONFIG_XIP_KERNEL is not set
CONFIG_ELF=y
# CONFIG_XIP_ELF is not set
CONFIG_RAM_START=0x80400000
CONFIG_RAM_SIZE=8388608
CONFIG_FS_TMPFS_HEAP_INDEX=1
CONFIG_EXAMPLES_LOADABLE=y
CONFIG_EXAMPLES_HELLO=y
CONFIG_SCHED_CHILD_STATUS=y
CONFIG_TC_KERNEL_GROUP=y
CONFIG_TC_KERNEL_IRQ=y
CONFIG_TC_KERNEL_PIPE=y
CONFIG_TC_KERNEL_PROCFS=y
CONFIG_TC_KERNEL_VFS=y
CONFIG_FS_AUTOMOUNT_PROCFS=y
CONFIG_FLASH_START_ADDR=0x80c00000
CONFIG_FLASH_SIZE=4194304
CONFIG_FLASH_MINOR=0
CONFIG_FLASH_PARTITION=y
CONFIG_FLASH_PART_SIZE="640,768,384,128,640,768,384,128,248,8,"
CONFIG_FLASH_PART_TYPE="kernel,bin,bin,bin,kernel,bin,bin,bin,none,bootparam,"
CONFIG_FLASH_PART_NAME="kernel,common,app1,app2,kernel,common,app1,app2,reserved,bootparam,"
CONFIG_MTD=y
CONFIG_MTD_PARTITION=y
CONFIG_MTD_PARTITION_NAMES=y
CONFIG_BCH=y
# CONFIG_MTD_PROGMEM is not set
CONFIG_MTD_FTL=y
CONFIG_MTD_BYTE_WRITE=y
CONFIG_RAMMTD=y
# CONFIG_RAMMTD_ERASE_ON_INIT is not set
CONFIG_USE_BP=y
CONFIG_BINARY_MANAGER=y
CONFIG_DEBUG_BINMGR=y
CONFIG_DEBUG_BINMGR_ERROR=y
CONFIG_BINMGR_UPDATE=y
# CONFIG_BINMGR_UPDATE_SAME_VERSION is not set
CONFIG_BINMGR_RELOAD_REBOOT=y
CONFIG_LIB_HASHMAP=y
```

## os/arch/arm/src/qemu-armv8m/Kconfig
```kconfig
#
# For a description of the syntax of this configuration file,
# see kconfig-language at https://www.kernel.org/doc/Documentation/kbuild/kconfig-language.txt
#

comment "QEMU ARMv8-M Configuration Options"

config ARCH_CHIP_MPS2_AN505
	bool "MPS2-AN505"
	default y
	depends on ARCH_CHIP_QEMU_ARMV8M
	select ARCH_CORTEXM33
	select ARCH_HAVE_UART0
	select ARCH_HAVE_SERIAL_TERMIOS
	---help---
		QEMU MPS2-AN505 Cortex-M33 machine.
```

## os/board/lm3s6965-ek/Kconfig
```kconfig
#
# For a description of the syntax of this configuration file,
# see kconfig-language at https://www.kernel.org/doc/Documentation/kbuild/kconfig-language.txt
#

if ARCH_BOARD_LM3S6965EK

choice
	prompt "Build for qemu hardware"
	default QEMU_NONE

config QEMU_SRAM
	bool "Build for SRAM increased QEMU Hardware"
	---help---
		Build for SRAM increased QEMU Hardware.

config QEMU_SDRAM
	bool "Build for SDRAM(External RAM) enabled QEMU Hardware"
	---help---
		Build for SDRAM(External RAM) enabled QEMU Hardware.

config QEMU_NONE
	bool "NONE"
	---help---
		Dont build for Qemu Hardware.
endchoice

config QEMU_TEST_STORAGE
	bool "Initialize RAM storage for QEMU testcases"
	default n
	depends on QEMU_SRAM || QEMU_SDRAM
	depends on RAMMTD && MTD_SMART && FS_SMARTFS
	depends on !SMARTFS_MULTI_ROOT_DIRS
	select BOARD_INITIALIZE
	select MTD_FTL
	---help---
		Create separate volatile RAM MTD devices for the SmartFS examples
		(/dev/smart0 mounted at /mnt), filesystem tests (/dev/smart1,
		formatted but not mounted), and raw BCH tests (/dev/mtdblock1).
		Each SMART device uses 256 erase blocks and the BCH device uses
		16 erase blocks. All contents are reset on each boot.

endif
```
